## layers/meta-balena-ultra96-zynqmp/conf/layer.conf
```bitbake
# needs to point to the build directory. "analogous to $PATH"
BBPATH .= ":${LAYERDIR}"

# list of recipe files
BBFILES += "${LAYERDIR}/recipes-*/*/*.bb \
            ${LAYERDIR}/recipes-*/*/*.bbappend"

# list names of configured layers

# expands to match files from BBFILES in a particular layer
BBFILE_PATTERN_ultra96-zynqmp := "^${LAYERDIR}/"

# maxes precedence for our layer
BBFILE_PRIORITY_ultra96-zynqmp = "1337"

# compatible yocto versions
LAYERSERIES_COMPAT_skeleton = "warrior thud"
LAYERSERIES_COMPAT_ultra96-zynqmp = "warrior thud"

# extra distro features
DISTRO_FEATURES_append = "systemd virtualization"
```
